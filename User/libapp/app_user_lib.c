/*
*********************************************************************************************************
*	                                  
*	模块名称 : 用户库文件
*	文件名称 : app_user_lib.c
*	版    本 : V1.0
*	说    明 : 当前主要是文件系统FlashFS的函数，以供外部文件调用。
*
*	修改记录 :
*		版本号    日期         作者         说明
*       V1.0    2016-02-16   Eric2013       首发
*
*	Copyright (C), 2015-2020, 安富莱电子 www.armfly.com
*
*********************************************************************************************************
*/
#include "includes.h"




/*
*********************************************************************************************************
*	                                  用于本文件的调试
*********************************************************************************************************
*/
#if 0
	#define printf_libdbg printf
#else
	#define printf_libdbg(...)
#endif


/*
*********************************************************************************************************
*	                                         用于SD卡
*********************************************************************************************************
*/
FILE *foutbmp;
uint32_t bw;
Media_INFO info;
FAT_VI *mc0;  
uint64_t ullSdUnusedCapacity;
uint64_t ullSdCapacity;
	

/* FlashFS API的返回值 */
const char * ReVal_Table[]= 
{
	"0：成功",				                        
	"1：IO错误，I/O驱动初始化失败，或者没有存储设备，或者设备初始化失败",
	"2：卷错误，挂载失败，对于FAT文件系统意味着无效的MBR，启动记录或者非FAT格式",
	"3：FAT日志初始化失败，FAT初始化成功了，但是日志初始化失败",
};


/*
*********************************************************************************************************
*	函 数 名: DotFormatjavascript:;
*	功能说明: 将数据规范化显示，方便用户查看
*             比如
*             2345678   ---->  2.345.678
*             334426783 ---->  334.426.783
*             以三个数为单位进行显示
*	形    参: _ullVal   需要规范显示的数值
*             _sp       规范显示后数据存储的buf。
*	返 回 值: 无
*********************************************************************************************************
*/
static void DotFormat(uint64_t _ullVal, char *_sp) 
{
	/* 数值大于等于10^9 */
	if (_ullVal >= (U64)1e9) 
	{
		_sp += sprintf (_sp, "%d.", (uint32_t)(_ullVal / (uint64_t)1e9));
		_ullVal %= (uint64_t)1e9;
		_sp += sprintf (_sp, "%03d.", (uint32_t)(_ullVal / (uint64_t)1e6));
		_ullVal %= (uint64_t)1e6;
		sprintf (_sp, "%03d.%03d", (uint32_t)(_ullVal / 1000), (uint32_t)(_ullVal % 1000));
		return;
	}
	
	/* 数值大于等于10^6 */
	if (_ullVal >= (uint64_t)1e6) 
	{
		_sp += sprintf (_sp,"%d.", (uint32_t)(_ullVal / (uint64_t)1e6));
		_ullVal %= (uint64_t)1e6;
		sprintf (_sp,"%03d.%03d", (uint32_t)(_ullVal / 1000), (uint32_t)(_ullVal % 1000));
		return;
	}
	
	/* 数值大于等于10^3 */
	if (_ullVal >= 1000) 
	{
		sprintf (_sp, "%d.%03d", (uint32_t)(_ullVal / 1000), (uint32_t)(_ullVal % 1000));
		return;
	}
	
	/* 其它数值 */
	sprintf (_sp,"%d",(U32)(_ullVal));
}

/*
*********************************************************************************************************
*	函 数 名: MountSD
*	功能说明: SD卡的挂载及其容量获取。
*	形    参: 无
*	返 回 值: 无
*********************************************************************************************************
*/
void MountSD(void)
{
	uint8_t result; 
	uint8_t buf[15];

	/* 获取相应存储设备的句柄 */
	mc0 = ioc_getcb("M0");          
   
	/* 初始化FAT文件系统格式的存储设备 */
	if (ioc_init (mc0) == 0) 
	{
		/* 获取存储设备的扇区信息 */
		ioc_read_info (&info, mc0);

		/* 总的扇区数 * 扇区大小，SD卡的扇区大小是512字节 */
		ullSdCapacity = (uint64_t)info.block_cnt << 9;
		DotFormat(ullSdCapacity, (char *)buf);
		printf_libdbg("SD卡总容量 = %10s字节\r\nSD卡的总扇区数 = %d \r\n", buf, info.block_cnt);
	
		printf_libdbg("SD卡读扇区大小 = %d字节\r\n", info.read_blen);
		printf_libdbg("SD卡写扇区大小 = %d字节\r\n", info.write_blen);
	}
	else 
	{
		printf_libdbg("初始化失败\r\n");
		return;
	}
	
	/* 卸载SD卡 */
	if(ioc_uninit (mc0) != NULL)
	{
		printf_libdbg("卸载SD卡失败\r\n");	
		return;		
	}
	else
	{
		printf_libdbg("卸载SD卡成功\r\n");	
	}
	
	/* 加载SD卡 */
	result = finit("M0:");
	if(result != NULL)
	{
		/* 如果挂载失败，务必不要再调用FlashFS的其它API函数，防止进入硬件异常 */
		printf_libdbg("挂载文件系统失败 (%s)\r\n", ReVal_Table[result]);
		return;
	}
	else
	{
		printf_libdbg("挂载文件系统成功 (%s)\r\n", ReVal_Table[result]);
	}
	printf_libdbg("------------------------------------------------------------------\r\n");

	/* 获取SD卡剩余容量 */
	ullSdUnusedCapacity = ffree("M0:");
	DotFormat(ullSdUnusedCapacity, (char *)buf);
	printf_libdbg("SD卡剩余容量 = %10s字节\r\n", buf);
	printf_libdbg("------------------------------------------------------------------\r\n");

}

/*
*********************************************************************************************************
*	函 数 名: UnmountSD
*	功能说明: 卸载SD卡
*	形    参: 无
*	返 回 值: 无
*********************************************************************************************************
*/
void UnmountSD(void)
{
	uint8_t result;

	/* 卸载SD卡 */
	result = funinit("M0:");
	if(result != NULL)
	{
		printf_libdbg("卸载文件系统失败\r\n");
	}
	else
	{
		printf_libdbg("卸载文件系统成功\r\n");
	}
}

/*
*********************************************************************************************************
*	函 数 名: _WriteByte2File()
*	功能说明: 写文件到SD卡或者其他存储介质
*	形    参：Data 要写的数据， p 指向FIL类型变量      	
*	返 回 值: 无
*********************************************************************************************************
*/
void _WriteByte2File(U8 Data, void * p) 
{
	bw = fwrite (&Data, 1, 1, p);
}

/***************************** 安富莱电子 www.armfly.com (END OF FILE) *********************************/
